## ZMK_Config_Files/Kconfig.defconfig
```kconfig
if SHIELD_rzr36v2_left

config ZMK_KEYBOARD_NAME
		default "rzr36v2"
	
config ZMK_SPLIT_ROLE_CENTRAL
		default y
		
config SPI
		default y

endif	

if SHIELD_rzr36v2_left || SHIELD_rzr36v2_right	

config I2C 
		default n

config ZMK_SPLIT
		default y

config SPI
		default y


config ZMK_KSCAN_MATRIX_POLLING
		default y


endif #overall		
```

## ZMK_Config_Files/Kconfig.shield
```kconfig
# Test_001

config SHIELD_rzr36v2_left
	def_bool $(shields_list_contains,rzr36v2_left)
	select SPI
	
config SHIELD_rzr36v2_right
	def_bool $(shields_list_contains,rzr36v2_right)
	select SPI
```
